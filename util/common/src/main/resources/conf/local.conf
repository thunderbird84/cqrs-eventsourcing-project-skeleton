## util/common/src/main/resources/conf/local.conf
```bitbake
include "application"

redis {
  host = "redis.robin.examples"
  port = 6379
}

rabbitmq {
  uri="amqp://guest:guest@qpid.robin.examples:5672"
}

jdbc {
  uri="amqp://guest:guest@qpid.robin.examples:5672"
}
```
